## drivers/bldc/Kconfig
```kconfig
# SPDX-FileCopyrightText: Copyright (c) 2025 Jilay Sandeep Pandya
# SPDX-License-Identifier: Apache-2.0

menuconfig BLDC
    bool "BLDC Controller"
    help
      Enable BLDC controller

if BLDC

module = BLDC
module-str = bldc
source "subsys/logging/Kconfig.template.log_config"

config BLDC_INIT_PRIORITY
    int "BLDC Motor Controller init priority"
    default 90
    help
      BLDC motor controller initialization priority.

comment "BLDC Drivers"

# zephyr-keep-sorted-start
rsource "Kconfig.st_l6235"
#zephyr-keep-sorted-stop

endif
```

## drivers/bldc/Kconfig.st_l6235
```kconfig
# SPDX-FileCopyrightText: Copyright (c) 2025 Jilay Sandeep Pandya
# SPDX-License-Identifier: Apache-2.0

config ST_L6235
    bool "ST L6235 BLDC Motor Controller"
    depends on DT_HAS_ST_L6235_ENABLED
    default y
```

## drivers/stepper/Kconfig.h_bridge_stepper
```kconfig
# SPDX-FileCopyrightText: Copyright (c) 2025 Jilay Sandeep Pandya
# SPDX-License-Identifier: Apache-2.0

config H_BRIDGE_STEPPER
	bool "Activate driver for h bridge stepper control"
	depends on DT_HAS_ZEPHYR_H_BRIDGE_STEPPER_ENABLED
	default y
```

## drivers/stepper/adi_tmc/Kconfig
```kconfig
# SPDX-FileCopyrightText: Copyright (c) 2024 Carl Zeiss Meditec AG
# SPDX-License-Identifier: Apache-2.0

menuconfig STEPPER_ADI_TMC
	bool "Trinamic Stepper Controller"
	depends on STEPPER
	default y
	help
	  Enable trinamic stepper controller

if STEPPER_ADI_TMC

comment "Trinamic Stepper Drivers"

rsource "Kconfig.tmc22xx"
rsource "Kconfig.tmc50xx"

endif # STEPPER_ADI_TMC
```

## drivers/stepper/adi_tmc/Kconfig.tmc50xx
```kconfig
# SPDX-FileCopyrightText: Copyright (c) 2024 Fabian Blatz <fabianblatz@gmail.com>
# SPDX-FileCopyrightText: Copyright (c) 2025 Jilay Sandeep Pandya
# SPDX-License-Identifier: Apache-2.0

config STEPPER_ADI_TMC50XX
	bool "Activate trinamic tmc50xx stepper driver"
	depends on DT_HAS_ADI_TMC50XX_ENABLED
	select STEPPER_ADI_TMC_SPI
	default y

config STEPPER_ADI_TMC50XX_MOTION_CONTROLLER
	bool "Activate trinamic tmc50xx motion controller"
	depends on DT_HAS_ADI_TMC50XX_MOTION_CONTROLLER_ENABLED
	select STEPPER_ADI_TMC50XX
	default y

config STEPPER_ADI_TMC50XX_STEPPER_DRIVER
	bool "Activate trinamic tmc51xx stepper driver"
	depends on DT_HAS_ADI_TMC50XX_STEPPER_DRIVER_ENABLED
    select STEPPER_ADI_TMC50XX
	default y

module = TMC50XX
module-str = tmc50xx
rsource "Kconfig.tmc_rampgen_template"
```

## drivers/stepper/adi_tmc/Kconfig.tmc_spi
```kconfig
# SPDX-FileCopyrightText: Copyright (c) 2025 Jilay Sandeep Pandya
# SPDX-License-Identifier: Apache-2.0

config STEPPER_ADI_TMC_SPI
	bool "Use Trinamic Stepper Controller with SPI"
	depends on STEPPER_ADI_TMC
	select SPI
	help
	  A Trinamic Stepper Controller with SPI is enabled

config STEPPER_ADI_$(module)_PARSE_RX_DATA
	bool "$(module-str) parse RX data"
	depends on STEPPER_ADI_TMC_SPI
	help
	  When enabled, the RX data will be parsed.
```

## drivers/stepper/gpio_stepper/Kconfig
```kconfig
# Copyright (c) 2024 Fabian Blatz <fabianblatz@gmail.com>
# SPDX-License-Identifier: Apache-2.0

comment "GPIO Stepper Controllers"

config GPIO_STEPPER
	bool
	help
	  Enable library used for gpio based stepper controllers.

if GPIO_STEPPER

config GPIO_STEPPER_COUNTER_TIMING
	bool "Counter use for stepping"
	select COUNTER
	default y
	help
	  Enable usage of a counter device for accurate stepping.

module = GPIO_STEPPER
module-str = gpio_stepper
rsource "../Kconfig.stepper_event_template"

endif # GPIO_STEPPER

rsource "Kconfig.gpio_step_dir"
rsource "Kconfig.h_bridge"
```

## drivers/stepper/gpio_stepper/common/Kconfig
```kconfig
config GPIO_STEPPER
	bool
	help
	  Enable library used for gpio based stepper controllers.

if GPIO_STEPPER

config GPIO_STEPPER_COUNTER_TIMING
	bool "Counter use for stepping"
	select COUNTER
	default y
	help
	  Enable usage of a counter device for accurate stepping.

module = GPIO_STEPPER
module-str = gpio_stepper
source "drivers/stepper/Kconfig.stepper_event_template"

endif # GPIO_STEPPER
```

## drivers/stepper/motion_controller/Kconfig
```kconfig
# SPDX-FileCopyrightText: Copyright (c) 2023 Carl Zeiss Meditec AG
#                         Copyright (c) 2025 Andre Stefanov <mail@andrestefanov.de>
# SPDX-License-Identifier: Apache-2.0
comment "Stepper motion controller"

rsource "ramp/Kconfig"
```

## drivers/stepper_control/zephyr_stepper_motion_control/Kconfig
```kconfig
# SPDX-FileCopyrightText: Copyright (c) 2025 Jilay Sandeep Pandya
# SPDX-License-Identifier: Apache-2.0

config ZEPHYR_STEPPER_MOTION_CONTROL
	bool "Zephyr SW based Stepper motor control"
	depends on DT_HAS_ZEPHYR_STEPPER_CONTROL_ENABLED
	default y

if ZEPHYR_STEPPER_MOTION_CONTROL

config ZEPHYR_STEPPER_MOTION_CONTROL_COUNTER_TIMING
	bool "Counter use for stepping"
	select COUNTER
	default y
	help
	  Enable usage of a counter device for accurate stepping.

module = ZEPHYR_STEPPER_MOTION_CONTROL
module-str = zephyr_stepper_motion_control

rsource "../Kconfig.stepper_event_template"

endif
```

## dts/bindings/bldc/st,l6235.yaml
```yaml
# SPDX-FileCopyrightText: Copyright (c) 2025 Jilay Sandeep Pandya
# SPDX-License-Identifier: Apache-2.0

description: ST L6235 BLDC Controller

compatible: "st,l6235"

properties:
  dir-gpios:
    type: phandle-array
    description: Direction pin.

  en-gpios:
    type: phandle-array
    description: Enable pin.

  brk-gpios:
    type: phandle-array
    description: Brake pin.
```

## dts/bindings/stepper/pololu/pololu,a4988.yaml
```yaml
# Copyright (c) 2025 Your Name
# SPDX-License-Identifier: Apache-2.0

# DTS binding for the Allegro A4988 Stepper Motor Driver

description: |
  Allegro A4988 Stepper Motor Driver. This binding describes the hardware
  interface for controlling the A4988 chip, commonly found on carrier
  boards like those from Pololu.

  The driver requires STEP and DIR signals. ENABLE, microstepping (MSx),
  SLEEP, and RESET signals are optional but recommended for full control.

compatible: "allegro,a4988"

include: base.yaml # Includes 'label' property

properties:
  step-gpios:
    type: phandle-array
    required: true
    description: |
      GPIO specifier for the STEP pin. A rising edge on this pin typically
      commands the motor to take one step (or microstep).

  dir-gpios:
    type: phandle-array
    required: true
    description: |
      GPIO specifier for the DIR (Direction) pin. The logic level on this
      pin determines the direction of motor rotation.

  enable-gpios:
    type: phandle-array
    required: false
    description: |
      GPIO specifier for the ENABLE pin. This pin is typically active-low.
      When pulled low, the driver outputs are enabled. When high (or floating,
      depending on carrier pull-ups), the outputs are disabled (high impedance).
      If not provided, the driver might assume it's always enabled or tied
      to a default state by external hardware.

  ms1-gpios:
    type: phandle-array
    required: false
    description: |
      GPIO specifier for the MS1 (Microstep Select 1) pin. Used in conjunction
      with MS2 and MS3 to set the microstepping resolution.

  ms2-gpios:
    type: phandle-array
    required: false
    description: |
      GPIO specifier for the MS2 (Microstep Select 2) pin. Used in conjunction
      with MS1 and MS3 to set the microstepping resolution.

  ms3-gpios:
    type: phandle-array
    required: false
    description: |
      GPIO specifier for the MS3 (Microstep Select 3) pin. Used in conjunction
      with MS1 and MS2 to set the microstepping resolution.
      Refer to the A4988 datasheet for the truth table:
        MS1 | MS2 | MS3 | Resolution
        -----------------------------
         L  |  L  |  L  | Full step
         H  |  L  |  L  | Half step
         L  |  H  |  L  | 1/4 step
         H  |  H  |  L  | 1/8 step
         H  |  H  |  H  | 1/16 step
      If MS pins are not provided via GPIOs, the driver may assume a default
      resolution (e.g., full step) or rely on external pull-up/pull-down
      resistors on the carrier board setting a fixed resolution.

  sleep-gpios:
    type: phandle-array
    required: false
    description: |
      GPIO specifier for the SLEEP pin. This pin is typically active-low.
      Pulling it low puts the driver into a low-power sleep mode. If not
      provided, assumes the pin is tied high externally or not controlled
      by the MCU.

  reset-gpios:
    type: phandle-array
    required: false
    description: |
      GPIO specifier for the RESET pin. This pin is typically active-low.
      Pulling it low resets the internal translator logic. If not provided,
      assumes the pin is tied high externally or not controlled by the MCU.
      Note: On many Pololu carriers, RESET might be tied to SLEEP.

  steps-per-revolution:
    type: int
    required: false
    description: |
      The number of full steps the connected stepper motor takes for one
      complete revolution (e.g., 200 for a 1.8-degree step angle motor).
      This information can be used by higher-level motion control logic.
```

## dts/bindings/stepper/step-dir-control-signal-timing.yaml
```yaml
# SPDX-FileCopyrightText: Copyright (c) 2025 Jilay Sandeep Pandya
# SPDX-License-Identifier: Apache-2.0

description: Step/Dir Control Signal Timing

properties:
  pulse-width-ns:
    type: int
    description: |
      Pulse width in nanoseconds for the step signal.
      This is the minimum duration for which the step signal is asserted high.

  low-level-width-ns:
    type: int
    description: |
      Low level width in nanoseconds for the step signal.
      This is the minimum duration for which the step signal is asserted low.
```

## dts/bindings/stepper/step-dir-timing.yaml
```yaml
# SPDX-FileCopyrightText: Copyright (c) 2025 Jilay Sandeep Pandya
# SPDX-License-Identifier: Apache-2.0

description: Step/Dir Control Signal Timing

properties:
  high-level-width-ns:
    type: int
    description: |
      Pulse width in nanoseconds for the step signal.
      This is the minimum duration for which the step signal is asserted high.

  low-level-width-ns:
    type: int
    description: |
      Low level width in nanoseconds for the step signal.
      This is the minimum duration for which the step signal is asserted low.

  step-period-ns:
    type: int
    description: |
      Total period in nanoseconds for the step signal.

  dir-to-step-setup-time-ns:
    type: int
    description: |
      Setup time in nanoseconds from the direction signal change to the step signal.
      This is the minimum time that the direction signal must be stable before the step signal is asserted.

  dir-after-step-hold-time-ns:
    type: int
    description: |
      Hold time in nanoseconds after the step signal for the direction signal.
      This is the minimum time that the direction signal must remain stable after the step signal is deasserted.
```

## dts/bindings/stepper_control/zephyr, stepper-control.yaml
```yaml
# SPDX-FileCopyrightText: Copyright (c) 2024 Jilay Sandeep Pandya

description: |
    Stepper Controller for stepper motor drivers
    This binding is used to configure the stepper controller in Zephyr.
    It is used to control the stepper motor driver.
    
    Example:
    stepper_controller: stepper_controller {
        compatible = "zephyr,stepper-controller";
        stepper = <&stepper1>;
        step-tick-ns = <1000>;
    };

compatible: "zephyr,stepper-control"

properties:
    stepper:
        type: phandle
        required: true
        description: |
          The phandle to the stepper motor driver node.

    step-tick-ns:
        type: int
        required: true
        description: |
          The time in nanoseconds between each step signal.
```

## dts/bindings/stepper_control/zephyr,stepper-control.yaml
```yaml
# SPDX-FileCopyrightText: Copyright (c) 2024 Jilay Sandeep Pandya

description: |
    Stepper Controller for stepper motor drivers
    This binding is used to configure the stepper controller in Zephyr.
    It is used to control the stepper motor driver.

    Example:
    stepper_control: stepper_control {
        compatible = "zephyr,stepper-control";
        stepper = <&gpio_stepper>;
        step-tick-ns = <1000000>;
    };

compatible: "zephyr,stepper-control"

properties:
  step-tick-ns:
    type: int
    required: true
    description: |
      The time in nanoseconds between each step signal.

  counter:
    type: phandle
    description: Counter used for generating step-accurate pulse signals.
```

## tests/drivers/build_all/stepper/testcase.yaml
```yaml
# SPDX-FileCopyrightText: Copyright (c) 2023 Carl Zeiss Meditec AG
# SPDX-License-Identifier: Apache-2.0

common:
  build_only: true
  tags:
    - drivers
    - stepper
  platform_allow:
    - native_sim
    - native_sim/native/64

tests:
  drivers.stepper.build:
    tags: stepper
  drivers.stepper.no_default.build:
    extra_args: EXTRA_CONF_FILE=stepper_no_default.conf
```

## tests/drivers/stepper/ramp/testcase.yaml
```yaml
# SPDX-FileCopyrightText: Copyright (c) 2025 Andre Stefanov
# SPDX-License-Identifier: Apache-2.0

common:
  tags:
    - drivers
    - stepper
    - ramp
tests:
  drivers.stepper.ramp:
    platform_allow:
      - qemu_x86
```
