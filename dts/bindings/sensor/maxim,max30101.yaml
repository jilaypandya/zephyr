## dts/bindings/sensor/maxim,max30101.yaml
```yaml
description: MAX30101 heart rate sensor

compatible: "maxim,max30101"

include: [maxim,max3010x-common.yaml]

properties:
  led-pa:
    default: [ 0xff, 0xff, 0xff ]
```
